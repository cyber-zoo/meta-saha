## saha-layers/meta-tegra-saha/conf/distro/tegra-saha.conf
```bitbake
DISTRO = "tegra-saha"
DISTRO_NAME = "Saha project distro for tegra"
# Based on tegrademo 3.5
DISTRO_VERSION_BASE = "alpha-1.0"
DISTRO_VERSION = "${DISTRO_VERSION_BASE}-${DATE}"
DISTRO_CODENAME = "rolling"
SDK_VENDOR = "-tdsdk"
SDK_VERSION := "${DISTRO_VERSION}"

MAINTAINER = "Homalozoa <nx.tardis@gmail.com>"

TARGET_VENDOR = "-cyberzoo"

# New ${DISTRO}-<version> setting for sanity checks.
# Increment version number (and the corresponding
# setting int the template bblayers.conf.sample file)
# each time the layer settings are changed.
REQUIRED_TD_BBLAYERS_CONF_VERSION = "${DISTRO}-1"

LOCALCONF_VERSION = "1"

DISTRO_VERSION[vardepsexclude] = "DATE"
SDK_VERSION[vardepsexclude] = "DATE"

TD_DEFAULT_DISTRO_FEATURES = "largefile opengl vulkan multiarch systemd pam virtualization"

DISTRO_FEATURES ?= "${DISTRO_FEATURES_DEFAULT} ${TD_DEFAULT_DISTRO_FEATURES}"

# Jetson platforms do not use linux-yocto, but for QEMU testing
# align with the poky distro.
PREFERRED_VERSION_linux-yocto ?= "5.8%"
PREFERRED_VERSION_linux-yocto-rt ?= "5.4%"

SDK_NAME = "${DISTRO}-${TCLIBC}-${SDKMACHINE}-${IMAGE_BASENAME}-${TUNE_PKGARCH}-${MACHINE}"
SDKPATH = "/opt/${DISTRO}/${SDK_VERSION}"

TCLIBCAPPEND = ""

PREMIRRORS ??= "\
bzr://.*/.*   http://downloads.yoctoproject.org/mirror/sources/ \n \
cvs://.*/.*   http://downloads.yoctoproject.org/mirror/sources/ \n \
git://.*/.*   http://downloads.yoctoproject.org/mirror/sources/ \n \
gitsm://.*/.* http://downloads.yoctoproject.org/mirror/sources/ \n \
hg://.*/.*    http://downloads.yoctoproject.org/mirror/sources/ \n \
osc://.*/.*   http://downloads.yoctoproject.org/mirror/sources/ \n \
p4://.*/.*    http://downloads.yoctoproject.org/mirror/sources/ \n \
svn://.*/.*   http://downloads.yoctoproject.org/mirror/sources/ \n"

SANITY_TESTED_DISTROS ?= " \
            ubuntu-18.04 \n \
            ubuntu-20.04 \n \
            ubuntu-20.10 \n \
            ubuntu-21.04 \n \
            ubuntu-22.04 \n \
            arch \n \
            "

# CUDA 10.2 requires gcc 7 or 8
GCCVERSION:aarch64 = "8.%"
SDKGCCVERSION = "11.%"

# Most NVIDIA-supplied services expect systemd
INIT_MANAGER = "systemd"

INHERIT += "tegra-support-sanity"

require conf/distro/include/no-static-libs.inc
require conf/distro/include/yocto-uninative.inc
require conf/distro/include/security_flags.inc
INHERIT += "uninative"

BB_SIGNATURE_HANDLER ?= "OEEquivHash"
BB_HASHSERVE ??= "auto"

LICENSE_FLAGS_ACCEPTED += "commercial_faad2"

PREFERRED_PROVIDER_virtual/bootlogo_tegra = "bootlogo-custom"

# # Mender additions
# INHERIT += "mender-full distro_layer_buildinfo"
# INHERIT:append:tegra = " tegra-mender-setup mender-workarounds"

# BUILDNAME ?= "${DISTRO_VERSION}-${DISTRO_LAYER_BUILDTAG}"
# BUILDNAME[vardepvalue] = "${DISTRO_VERSION}"

# MENDER_ARTIFACT_NAME ?= "${IMAGE_BASENAME}_${BUILDNAME}"

# IMAGE_FSTYPES:tegra = "tegraflash mender dataimg"
# IMAGE_FSTYPES:pn-tegra-minimal-initramfs:tegra = "${INITRAMFS_FSTYPES}"
# IMAGE_FEATURES:append = " read-only-rootfs"
# IMGCLASSES:append = " rootfs-postcommands-overrides"

# # Reserved space for tegraflash partitions, not including APP and DATA
# TEGRA_FLASH_PARTITIONS_MB ?= "950"

# # Make more room for the data partition, so we can use it to hold
# # docker container filesystems.
# MENDER_DATA_PART_SIZE_MB_DEFAULT:tegra = "3072"

# MENDER_STORAGE_DEVICE_BASE ?= "/dev/mmcblk0p"
# MENDER_STORAGE_TOTAL_SIZE_MB ?= "${@tegra_mender_calc_total_size(d) - int(d.getVar('TEGRA_FLASH_PARTITIONS_MB'))}"
```

## saha-layers/meta-tegra-saha/conf/layer.conf
```bitbake
BBPATH =. "${LAYERDIR}:"
BBFILES += "${LAYERDIR}/recipes-*/*/*.bb ${LAYERDIR}/recipes-*/*/*.bbappend"

BBFILE_COLLECTIONS += "tegra-saha"
BBFILE_PATTERN_tegra-saha = "^${LAYERDIR}/"
BBFILE_PRIORITY_tegra-saha = "50"

LAYERVERSION_tegra-saha = "4"
LAYERSERIES_COMPAT_tegra-saha = "honister"

# This is used by the tegra-distro-sanity bbclass
# to identify the distro layer directory during
# bblayers checks.
TD_DISTRO_LAYERDIR = "${LAYERDIR}"
```

## saha-layers/meta-tegra-saha/conf/machine/apollo-nx.conf
```bitbake
#@TYPE: Machine
#@NAME: Nvidia Jetson Orin NX
#@DESCRIPTION: Nvidia Jetson Orin NX module in P3509 carrier

TEGRA_BOARDID ?= "3767"
TEGRA_FAB ?= "ES1"
TEGRA_BOARDSKU ?= "0000"
TEGRA_BOARDREV ?= "A.3"
TEGRA_CHIPREV ?= "1"
NVPMODEL ?= "nvpmodel_p3767_0000"
NVFANCONTROL ?= "nvfancontrol_p3767_0000"

TNSPEC_BOOTDEV = "nvme0n1p1"
BOOT_PARTITIONS_ON_EMMC = "0"
TEGRAFLASH_NO_INTERNAL_STORAGE = "1"

require conf/machine/include/orin-chips.inc
require conf/machine/include/devkit-wifi.inc

INITRAMFS_IMAGE = ""

KERNEL_DEVICETREE ?= "tegra234-p3767-0000-p3509-a02.dtb"
KERNEL_ARGS ?= "root=/dev/nvme0n1p1 rw rootwait rootfstype=ext4 mminit_loglevel=4 console=ttyTCU0,115200 firmware_class.path=/etc/firmware fbcon=map:0 net.ifnames=0"
MACHINE_EXTRA_RRECOMMENDS += "kernel-module-r8168 kernel-module-r8169 kernel-module-realtek"
MACHINE_EXTRA_RDEPENDS += "linux-firmware-rtl8168"

EMMC_SIZE ?= ""
BOOTPART_SIZE ?= "8388608"
# 55GiB default rootfs size
ROOTFSPART_SIZE ?= "59055800320"
ODMDATA ?= "gbe-uphy-config-8,hsstp-lane-map-3,hsio-uphy-config-0"
EMMC_BCT ?= "tegra234-p3767-0000-sdram-l4t.dts"
NVIDIA_BOARD ?= "t186ref"
PARTITION_LAYOUT_TEMPLATE = "flash_qspi_apollo-nx.xml"
PARTITION_LAYOUT_EXTERNAL = "flash_apollo-nx.xml"
TEGRA_AUDIO_DEVICE ?= "tegra-hda-p3767-p3509"

OTABOOTDEV ?= "/dev/mtdblock0"
OTAGPTDEV ?= "/dev/mtdblock0"

TEGRA_PLUGIN_MANAGER_OVERLAYS ?= "tegra234-p3767-0000-p3509-a02-hdr40.dtbo"

# Board configuration
# BOARD_TYPE ?= "Rolling_A310"
MACHINE_FEATURES += "wifi bluetooth"
# MACHINE_EXTRA_RRECOMMENDS += " \
#     tegra-firmware-rtl8822 \
#     kernel-module-rtk-btusb \
#     kernel-module-rtl8822ce \
#     kernel-module-can \
#     kernel-module-can-raw \
#     kernel-module-can-bcm \
#     kernel-module-can-gw \
#     kernel-module-mttcan \
# "
# KERNEL_MODULE_AUTOLOAD += " \
#     can \
#     can-raw \
#     can-bcm \
#     can-gw \
#     can-dev \
#     mttcan \
# "
```

## saha-layers/meta-tegra-saha/conf/machine/rolling-nx.conf
```bitbake
#@TYPE: Machine
#@NAME: Rolling cerebrum based on Nvidia Jetson Xavier NX eMMC
#@DESCRIPTION: Rolling cerebrum based on Nvidia Jetson Xavier NX QSPI+eMMC
#              module

TEGRA_BOARDSKU ?= "0001"
TEGRA_BUPGEN_SPECS ?= " \
    fab=100;boardsku=0001;boardrev= \
    fab=200;boardsku=0001;boardrev= \
    fab=300;boardsku=0001;boardrev= \
    fab=301;boardsku=0001;boardrev= \
    fab=301;boardsku=0003;boardrev= \
"
IMAGE_ROOTFS_ALIGNMENT ?= "4"

require conf/machine/include/xavier-nx.inc
MACHINEOVERRIDES = "cuda:tegra:tegra194:xavier-nx:jetson-xavier-nx-devkit-emmc:${MACHINE}"

EMMC_SIZE ?= "15758000128"
PARTITION_LAYOUT_TEMPLATE ?= "flash_t194_uefi_spi_emmc_p3668.xml"
BOOT_PARTITIONS_ON_EMMC = "1"
PREFERRED_PROVIDER_virtual/kernel ?= "tegra-rolling-kernel"

# Board configuration
# BOARD_TYPE ?= "Rolling_A310"
MACHINE_FEATURES += "wifi bluetooth"
MACHINE_EXTRA_RRECOMMENDS += " \
    tegra-firmware-rtl8822 \
	kernel-module-rtk-btusb \
	kernel-module-rtl8822ce \
	kernel-module-can \
	kernel-module-can-raw \
	kernel-module-can-bcm \
	kernel-module-can-gw \
	kernel-module-mttcan \
"
KERNEL_MODULE_AUTOLOAD += " \
    can \
    can-raw \
	can-bcm \
	can-gw \
	can-dev \
    mttcan \
"

# Peripherals configuration
# PREFERRED_VERSION_librealsense2 ?= "2.50.0"
```
