## saha-layers/meta-allwinner-saha/conf/layer.conf
```bitbake
BBPATH .= ":${LAYERDIR}"
BBFILES += "${LAYERDIR}/recipes-*/*/*.bb ${LAYERDIR}/recipes-*/*/*.bbappend"
BBFILE_COLLECTIONS += "allwinner-saha"
BBFILE_PATTERN_allwinner-saha = "^${LAYERDIR}/"
BBFILE_PRIORITY_allwinner-saha = "50"
LAYERVERSION_allwinner-saha = "1"
LAYERSERIES_COMPAT_allwinner-saha = "wrynose"
LAYERDEPENDS_allwinner-saha = "core allwinner saha-microduck"
```

## saha-layers/meta-allwinner-saha/conf/machine/include/orangepi-zero3w-microduck.inc
```bitbake
KERNEL_DEVICETREE = "allwinner/sun60i-a733-orangepi-zero3w-microduck.dtb"
SERIAL_CONSOLES = ""
ALLWINNER_BOOT_CONSOLE = "console=tty1"
MACHINE_FEATURES:append = " alsa bluetooth wifi"
MACHINE_EXTRA_RRECOMMENDS += "saha-orangepi-microduck"
```

## saha-layers/meta-qcom-saha/conf/distro/saha-qcom.conf
```bitbake
DISTRO = "saha-qcom"
DISTRO_NAME = "Saha project distro for Qualcomm Dragonwing"
DISTRO_VERSION_BASE = "alpha-1.0"
DISTRO_VERSION = "${DISTRO_VERSION_BASE}-${DATE}"
DISTRO_CODENAME = "wrynose"
SDK_VENDOR = "-qcom"
SDK_VERSION := "${DISTRO_VERSION}"

MAINTAINER = "Homalozoa <nx.tardis@gmail.com>"
TARGET_VENDOR = "-cyberzoo"

LOCALCONF_VERSION = "1"

DISTRO_VERSION[vardepsexclude] = "DATE"
SDK_VERSION[vardepsexclude] = "DATE"

# Keep the platform-neutral Saha feature contract while adding EFI, which is
# required by the IQ-9075 EVK U-Boot/UEFI boot path.
SAHA_QCOM_DISTRO_FEATURES = "largefile opengl vulkan multiarch systemd pam virtualization wifi efi"
DISTRO_FEATURES ?= "${DISTRO_FEATURES_DEFAULTS} ${SAHA_QCOM_DISTRO_FEATURES}"

INIT_MANAGER = "systemd"

INHERIT += "uninative"

BB_SIGNATURE_HANDLER ?= "OEEquivHash"
BB_HASHSERVE ??= "auto"

LICENSE_FLAGS_ACCEPTED += "commercial_faad2"

SDK_NAME = "${DISTRO}-${TCLIBC}-${SDKMACHINE}-${IMAGE_BASENAME}-${TUNE_PKGARCH}-${MACHINE}"
SDKPATH = "/opt/${DISTRO}/${SDK_VERSION}"
```

## saha-layers/meta-qcom-saha/conf/layer.conf
```bitbake
BBPATH .= ":${LAYERDIR}"

BBFILES += " \
    ${LAYERDIR}/recipes-*/*/*.bb \
    ${LAYERDIR}/recipes-*/*/*.bbappend \
"

BBFILE_COLLECTIONS += "qcom-saha"
BBFILE_PATTERN_qcom-saha = "^${LAYERDIR}/"
BBFILE_PRIORITY_qcom-saha = "50"

LAYERVERSION_qcom-saha = "1"
LAYERSERIES_COMPAT_qcom-saha = "wrynose"

LAYERDEPENDS_qcom-saha = " \
    core \
    saha-common \
    qcom \
"
```

## saha-layers/meta-rdk-x5-saha/conf/distro/saha-rdk-x5.conf
```bitbake
DISTRO = "saha-rdk-x5"
DISTRO_NAME = "Saha project distro for D-Robotics RDK X5"
DISTRO_VERSION_BASE = "alpha-1.0"
DISTRO_VERSION = "${DISTRO_VERSION_BASE}-${DATE}"
DISTRO_CODENAME = "wrynose"
SDK_VENDOR = "-sahardsdk"
SDK_VERSION := "${DISTRO_VERSION}"

MAINTAINER = "Homalozoa <nx.tardis@gmail.com>"
TARGET_VENDOR = "-saha"
LOCALCONF_VERSION = "1"

DISTRO_VERSION[vardepsexclude] = "DATE"
SDK_VERSION[vardepsexclude] = "DATE"

SAHA_RDK_X5_DISTRO_FEATURES = "largefile opengl systemd pam vfat"
DISTRO_FEATURES ?= "${DISTRO_FEATURES_DEFAULTS} ${SAHA_RDK_X5_DISTRO_FEATURES}"

INIT_MANAGER = "systemd"

INHERIT += "uninative"

BB_SIGNATURE_HANDLER ?= "OEEquivHash"
BB_HASHSERVE ??= "auto"
```

## saha-layers/meta-rockchip-saha/conf/layer.conf
```bitbake
BBPATH .= ":${LAYERDIR}"
BBFILES += "${LAYERDIR}/recipes-*/*/*.bb ${LAYERDIR}/recipes-*/*/*.bbappend"
BBFILE_COLLECTIONS += "rockchip-saha"
BBFILE_PATTERN_rockchip-saha = "^${LAYERDIR}/"
BBFILE_PRIORITY_rockchip-saha = "50"
LAYERVERSION_rockchip-saha = "1"
LAYERSERIES_COMPAT_rockchip-saha = "wrynose"
LAYERDEPENDS_rockchip-saha = "core rockchip saha-microduck"
```

## saha-layers/meta-saha-microduck/conf/layer.conf
```bitbake
BBPATH .= ":${LAYERDIR}"
BBFILES += "${LAYERDIR}/recipes-*/*/*.bb ${LAYERDIR}/recipes-*/*/*.bbappend"
BBFILE_COLLECTIONS += "saha-microduck"
BBFILE_PATTERN_saha-microduck = "^${LAYERDIR}/"
BBFILE_PRIORITY_saha-microduck = "41"
LAYERVERSION_saha-microduck = "1"
LAYERSERIES_COMPAT_saha-microduck = "wrynose"
LAYERDEPENDS_saha-microduck = "core saha-common multimedia-layer"
```
